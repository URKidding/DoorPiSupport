#ifndef BUTTON_HPP_INCLUDED
#define BUTTON_HPP_INCLUDED

#include <algorithm>
#include <array>
#include <Arduino.h>

namespace dps {
namespace button          {
// ~ ~ ~ ~ ~ ~ ~ ~ ~ ~ ~ ~ ~ ~ ~ ~ ~ ~ ~ ~ ~ ~ ~ ~ ~ ~ ~ ~ ~ ~ ~ ~ ~ ~ ~ ~ ~ ~ ~ ~ ~ ~ ~ ~ ~ ~ ~ ~ ~ ~ ~ ~ ~ ~ ~ ~ ~ ~ ~ ~ ~ ~ ~ ~ ~ ~ ~ ~ ~ ~ ~ ~ ~ ~ ~ ~ ~ ~ ~    

//==============================================================================================================================================================
enum State
{
    Released,
    Pressed,
    LongPress,
    _NrStates
};
//==============================================================================================================================================================

//==============================================================================================================================================================
class Button
{
//==============================================================================================================================================================
public:
//==============================================================================================================================================================
  enum : int
  {
    DebounceLimit_ms  =   50,
    LongLimit_ms      = 1000
  };



  //~~~~~~~~~~~~~~~~~~~~~~~~~~~~~~~~~~~~~~~~~~~~~~~~~~~~~~~~~~~~~~~~~~~~~~~~~~~~~~~~~~~~~~~~~~~~~~~~~~~~~~~~~~~~~~~~~~~~~~~~~~~~~~~~~~~~~~~~~~~~~~~~~~~~~~~~~~~~
  explicit Button(uint8_t io, char const* name, uint32_t polling_ms = 10) : Name(name), IO(io), Polling_ms(polling_ms)
  {
    pinMode(IO,  INPUT_PULLUP);
  }


  //~~~~~~~~~~~~~~~~~~~~~~~~~~~~~~~~~~~~~~~~~~~~~~~~~~~~~~~~~~~~~~~~~~~~~~~~~~~~~~~~~~~~~~~~~~~~~~~~~~~~~~~~~~~~~~~~~~~~~~~~~~~~~~~~~~~~~~~~~~~~~~~~~~~~~~~~~~~~
  bool operator()()
  {
    bool event       = false;
    auto pressed     = !digitalRead(IO);
    auto debounce_ms = Debounce_ms + (pressed ? Polling_ms : -Polling_ms);
    Debounce_ms      = std::max(std::min((int) debounce_ms, (int) DebounceLimit_ms), 0);

    switch (CurrentState)
    {
      // ~ ~ ~ ~ ~ ~ ~ ~ ~ ~ ~ ~ ~ ~ ~ ~ ~ ~ ~ ~ ~ ~ ~ ~ ~ ~ ~ ~ ~ ~ ~ ~ ~ ~ ~ ~ ~ ~ ~ ~ ~ ~ ~ ~ ~ ~ ~ ~ ~ ~ ~ ~ ~ ~ ~ ~ ~ ~ ~ ~ ~ ~ ~ ~ ~ ~ ~ ~ ~ ~ ~ ~ ~ ~ ~ ~
      case State::Released:
        if (Debounce_ms == DebounceLimit_ms)
        {
          Long_ms      = 0;
          CurrentState = State::Pressed;
          event        = true;
        }
        break;

      // ~ ~ ~ ~ ~ ~ ~ ~ ~ ~ ~ ~ ~ ~ ~ ~ ~ ~ ~ ~ ~ ~ ~ ~ ~ ~ ~ ~ ~ ~ ~ ~ ~ ~ ~ ~ ~ ~ ~ ~ ~ ~ ~ ~ ~ ~ ~ ~ ~ ~ ~ ~ ~ ~ ~ ~ ~ ~ ~ ~ ~ ~ ~ ~ ~ ~ ~ ~ ~ ~ ~ ~ ~ ~ ~ ~
      case State::Pressed:
        Long_ms += Polling_ms;
        if (Debounce_ms == 0) 
        {
          Long_ms      = 0;
          CurrentState = State::Released;
          event        = true;
        }
        else if (Long_ms >= LongLimit_ms)
        {
          CurrentState = State::LongPress;
          event        = true;
        }
        break;

      // ~ ~ ~ ~ ~ ~ ~ ~ ~ ~ ~ ~ ~ ~ ~ ~ ~ ~ ~ ~ ~ ~ ~ ~ ~ ~ ~ ~ ~ ~ ~ ~ ~ ~ ~ ~ ~ ~ ~ ~ ~ ~ ~ ~ ~ ~ ~ ~ ~ ~ ~ ~ ~ ~ ~ ~ ~ ~ ~ ~ ~ ~ ~ ~ ~ ~ ~ ~ ~ ~ ~ ~ ~ ~ ~ ~
      case State::LongPress:
        if (Debounce_ms == 0) 
        {
          Long_ms      = 0;
          CurrentState = State::Released;
          event        = true;
        }      
        break;
    }

    return event;
  }

  //~~~~~~~~~~~~~~~~~~~~~~~~~~~~~~~~~~~~~~~~~~~~~~~~~~~~~~~~~~~~~~~~~~~~~~~~~~~~~~~~~~~~~~~~~~~~~~~~~~~~~~~~~~~~~~~~~~~~~~~~~~~~~~~~~~~~~~~~~~~~~~~~~~~~~~~~~~~~
  State operator*() const
  {
    return CurrentState;
  }

  //~~~~~~~~~~~~~~~~~~~~~~~~~~~~~~~~~~~~~~~~~~~~~~~~~~~~~~~~~~~~~~~~~~~~~~~~~~~~~~~~~~~~~~~~~~~~~~~~~~~~~~~~~~~~~~~~~~~~~~~~~~~~~~~~~~~~~~~~~~~~~~~~~~~~~~~~~~~~
  char const* getStateText() const
  {
    return StateNames[CurrentState];
  }

  //~~~~~~~~~~~~~~~~~~~~~~~~~~~~~~~~~~~~~~~~~~~~~~~~~~~~~~~~~~~~~~~~~~~~~~~~~~~~~~~~~~~~~~~~~~~~~~~~~~~~~~~~~~~~~~~~~~~~~~~~~~~~~~~~~~~~~~~~~~~~~~~~~~~~~~~~~~~~
  char const*    Name;

//==============================================================================================================================================================
private:
//==============================================================================================================================================================
  uint8_t const                                    IO;
  uint32_t const                                   Polling_ms;

  State                                            CurrentState = State::Released;
  static std::array<char const*, State::_NrStates> StateNames;

  int                                              Long_ms     = 0;
  int                                              Debounce_ms = 0;
};
//==============================================================================================================================================================


// ~ ~ ~ ~ ~ ~ ~ ~ ~ ~ ~ ~ ~ ~ ~ ~ ~ ~ ~ ~ ~ ~ ~ ~ ~ ~ ~ ~ ~ ~ ~ ~ ~ ~ ~ ~ ~ ~ ~ ~ ~ ~ ~ ~ ~ ~ ~ ~ ~ ~ ~ ~ ~ ~ ~ ~ ~ ~ ~ ~ ~ ~ ~ ~ ~ ~ ~ ~ ~ ~ ~ ~ ~ ~ ~ ~ ~ ~ ~    
}} // namespace staircaselights::dps


#endif // BUTTON_HPP_INCLUDED
